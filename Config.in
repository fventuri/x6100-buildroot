## Config.in
```kconfig
source "$BR2_EXTERNAL_X6100_PATH/package/aether-x6100-control/Config.in"
source "$BR2_EXTERNAL_X6100_PATH/package/x6100-gui/Config.in"
source "$BR2_EXTERNAL_X6100_PATH/package/rhvoice/Config.in"
source "$BR2_EXTERNAL_X6100_PATH/package/ft8lib/Config.in"
source "$BR2_EXTERNAL_X6100_PATH/package/x6100-webserver/Config.in"
source "$BR2_EXTERNAL_X6100_PATH/package/python-bottle-sqlite/Config.in"
source "$BR2_EXTERNAL_X6100_PATH/package/libsndfile-with-lame-and-mpg123/Config.in"
source "$BR2_EXTERNAL_X6100_PATH/package/fate/Config.in"
```

## configs/X6100_defconfig
```kconfig
BR2_arm=y
BR2_cortex_a7=y
BR2_ARM_FPU_NEON_VFPV4=y
BR2_BINUTILS_VERSION_2_44_X=y
BR2_GCC_VERSION_14_X=y
BR2_TOOLCHAIN_BUILDROOT_CXX=y
BR2_CCACHE=y
BR2_CCACHE_INITIAL_SETUP="--max-size=32G"
BR2_OPTIMIZE_3=y
BR2_GLOBAL_PATCH_DIR="$(BR2_EXTERNAL_X6100_PATH)/board/X6100/patches"
BR2_SSP_REGULAR=y
BR2_RELRO_PARTIAL=y
BR2_TARGET_GENERIC_HOSTNAME="X6100"
BR2_TARGET_GENERIC_ISSUE="Welcome to the X6100 de R1CBU"
BR2_ROOTFS_DEVICE_CREATION_DYNAMIC_EUDEV=y
BR2_TARGET_GENERIC_ROOT_PASSWD="123"
BR2_SYSTEM_BIN_SH_BASH=y
BR2_SYSTEM_DHCP="eth0"
BR2_ROOTFS_OVERLAY="$(BR2_EXTERNAL_X6100_PATH)/board/X6100/linux/rootfs-overlay"
BR2_ROOTFS_POST_IMAGE_SCRIPT="support/scripts/genimage.sh"
BR2_ROOTFS_POST_SCRIPT_ARGS="-c $(BR2_EXTERNAL_X6100_PATH)/board/X6100/genimage.cfg"
BR2_LINUX_KERNEL=y
BR2_LINUX_KERNEL_PATCH="$(BR2_EXTERNAL_X6100_PATH)/board/X6100/linux"
BR2_LINUX_KERNEL_USE_CUSTOM_CONFIG=y
BR2_LINUX_KERNEL_CUSTOM_CONFIG_FILE="$(BR2_EXTERNAL_X6100_PATH)/board/X6100/linux/sun8i-r16-x6100_defconfig"
BR2_LINUX_KERNEL_CUSTOM_LOGO_PATH="$(BR2_EXTERNAL_X6100_PATH)/board/X6100/linux/logo.png"
BR2_LINUX_KERNEL_DTS_SUPPORT=y
BR2_LINUX_KERNEL_CUSTOM_DTS_DIR="$(BR2_EXTERNAL_X6100_PATH)/board/X6100/dts"
BR2_LINUX_KERNEL_INSTALL_TARGET=y
BR2_PACKAGE_LINUX_TOOLS_CPUPOWER=y
BR2_PACKAGE_LINUX_TOOLS_GPIO=y
BR2_PACKAGE_LINUX_TOOLS_IIO=y
BR2_PACKAGE_LINUX_TOOLS_PERF=y
BR2_PACKAGE_LINUX_TOOLS_PERF_TUI=y
BR2_PACKAGE_LINUX_TOOLS_TMON=y
BR2_PACKAGE_BUSYBOX_SHOW_OTHERS=y
BR2_PACKAGE_ALSA_UTILS=y
BR2_PACKAGE_ALSA_UTILS_ALSACONF=y
BR2_PACKAGE_ALSA_UTILS_ALSALOOP=y
BR2_PACKAGE_ALSA_UTILS_ALSAUCM=y
BR2_PACKAGE_ALSA_UTILS_ALSATPLG=y
BR2_PACKAGE_ALSA_UTILS_AMIXER=y
BR2_PACKAGE_ALSA_UTILS_APLAY=y
BR2_PACKAGE_ALSA_UTILS_ASEQDUMP=y
BR2_PACKAGE_ALSA_UTILS_ASEQNET=y
BR2_PACKAGE_ALSA_UTILS_IECSET=y
BR2_PACKAGE_ALSA_UTILS_SPEAKER_TEST=y
BR2_PACKAGE_BLUEZ_ALSA=y
BR2_PACKAGE_LAME=y
BR2_PACKAGE_MPG123=y
BR2_PACKAGE_PULSEAUDIO_DAEMON=y
BR2_PACKAGE_GETTEXT=y
BR2_PACKAGE_DOSFSTOOLS=y
BR2_PACKAGE_DOSFSTOOLS_FATLABEL=y
BR2_PACKAGE_DOSFSTOOLS_FSCK_FAT=y
BR2_PACKAGE_DOSFSTOOLS_MKFS_FAT=y
BR2_PACKAGE_E2FSPROGS=y
BR2_PACKAGE_FB_TEST_APP=y
BR2_PACKAGE_FBSET=y
BR2_PACKAGE_LINUX_FIRMWARE=y
BR2_PACKAGE_LINUX_FIRMWARE_RTL_87XX_BT=y
BR2_PACKAGE_LINUX_FIRMWARE_RTL_87XX=y
BR2_PACKAGE_LINUX_FIRMWARE_BROADCOM_TIGON3=y
BR2_PACKAGE_LINUX_FIRMWARE_BNX2X=y
BR2_PACKAGE_LINUX_FIRMWARE_CXGB4_T4=y
BR2_PACKAGE_LINUX_FIRMWARE_CXGB4_T5=y
BR2_PACKAGE_LINUX_FIRMWARE_INTEL_E100=y
BR2_PACKAGE_LINUX_FIRMWARE_INTEL_ICE=y
BR2_PACKAGE_LINUX_FIRMWARE_MICROCHIP_VSC85XX_PHY=y
BR2_PACKAGE_LINUX_FIRMWARE_QLOGIC_4X=y
BR2_PACKAGE_LINUX_FIRMWARE_RTL_815X=y
BR2_PACKAGE_LINUX_FIRMWARE_RTL_8169=y
BR2_PACKAGE_DBUS_CPP=y
BR2_PACKAGE_DBUS_TRIGGERD=y
BR2_PACKAGE_DT_UTILS=y
BR2_PACKAGE_EUDEV_RULES_GEN=y
BR2_PACKAGE_EVEMU=y
BR2_PACKAGE_EVTEST=y
BR2_PACKAGE_GPSD=y
BR2_PACKAGE_GPSD_DEVICES="/dev/ttyACM0"
BR2_PACKAGE_GPSD_ASHTECH=y
BR2_PACKAGE_GPSD_EARTHMATE=y
BR2_PACKAGE_GPSD_EVERMORE=y
BR2_PACKAGE_GPSD_FURY=y
BR2_PACKAGE_GPSD_FV18=y
BR2_PACKAGE_GPSD_GARMIN=y
BR2_PACKAGE_GPSD_GARMIN_SIMPLE_TXT=y
BR2_PACKAGE_GPSD_GEOSTAR=y
BR2_PACKAGE_GPSD_GPSCLOCK=y
BR2_PACKAGE_GPSD_GREIS=y
BR2_PACKAGE_GPSD_ISYNC=y
BR2_PACKAGE_GPSD_ITRAX=y
BR2_PACKAGE_GPSD_NMEA2000=y
BR2_PACKAGE_GPSD_OCEANSERVER=y
BR2_PACKAGE_GPSD_ONCORE=y
BR2_PACKAGE_GPSD_RTCM104V2=y
BR2_PACKAGE_GPSD_RTCM104V3=y
BR2_PACKAGE_GPSD_SIRF=y
BR2_PACKAGE_GPSD_SKYTRAQ=y
BR2_PACKAGE_GPSD_SUPERSTAR2=y
BR2_PACKAGE_GPSD_TRIMBLE_TSIP=y
BR2_PACKAGE_GPSD_TRIPMATE=y
BR2_PACKAGE_GPSD_TRUE_NORTH=y
BR2_PACKAGE_GPSD_UBX=y
BR2_PACKAGE_HWDATA_IAB_OUI_TXT=y
BR2_PACKAGE_I2C_TOOLS=y
BR2_PACKAGE_LIBUBOOTENV=y
BR2_PACKAGE_LSHW=y
BR2_PACKAGE_LSUIO=y
BR2_PACKAGE_PARTED=y
BR2_PACKAGE_PICOCOM=y
BR2_PACKAGE_POWERTOP=y
BR2_PACKAGE_SETSERIAL=y
BR2_PACKAGE_SPI_TOOLS=y
BR2_PACKAGE_STATSERIAL=y
BR2_PACKAGE_STM32FLASH=y
BR2_PACKAGE_USBUTILS=y
BR2_PACKAGE_PYTHON_SERIAL=y
BR2_PACKAGE_ALSA_PLUGINS=y
BR2_PACKAGE_LIBVORBIS=y
BR2_PACKAGE_OPUS=y
BR2_PACKAGE_SPEEX=y
BR2_PACKAGE_GNUTLS=y
BR2_PACKAGE_LIBMD=y
BR2_PACKAGE_LIBNSS=y
BR2_PACKAGE_GIFLIB=y
BR2_PACKAGE_JPEG=y
BR2_PACKAGE_LIBAIO=y
BR2_PACKAGE_LIBGPIOD2=y
BR2_PACKAGE_LIBGPIOD2_TOOLS=y
BR2_PACKAGE_LIBINPUT=y
BR2_PACKAGE_LIBXKBCOMMON=y
BR2_PACKAGE_NE10=y
BR2_PACKAGE_TSLIB=y
BR2_PACKAGE_JANSSON=y
BR2_PACKAGE_LOG4CPP=y
BR2_PACKAGE_LIBCURL=y
BR2_PACKAGE_LIBCURL_TLS_NONE=y
BR2_PACKAGE_FFTW=y
BR2_PACKAGE_FFTW_SINGLE=y
BR2_PACKAGE_FFTW_FAST=y
BR2_PACKAGE_GLIBMM=y
BR2_PACKAGE_GSL=y
BR2_PACKAGE_LIBBACKTRACE=y
BR2_PACKAGE_LIBUV=y
BR2_PACKAGE_LIQUID_DSP=y
BR2_PACKAGE_LIQUID_DSP_FAST=y
BR2_PACKAGE_ICU=y
BR2_PACKAGE_SHARED_MIME_INFO=y
BR2_PACKAGE_BLUEZ_TOOLS=y
BR2_PACKAGE_BLUEZ5_UTILS_OBEX=y
BR2_PACKAGE_BLUEZ5_UTILS_CLIENT=y
BR2_PACKAGE_BLUEZ5_UTILS_MONITOR=y
BR2_PACKAGE_BLUEZ5_UTILS_TOOLS=y
BR2_PACKAGE_BLUEZ5_UTILS_DEPRECATED=y
BR2_PACKAGE_BLUEZ5_UTILS_PLUGINS_HID=y
BR2_PACKAGE_IW=y
BR2_PACKAGE_NETWORK_MANAGER=y
BR2_PACKAGE_NETWORK_MANAGER_TUI=y
BR2_PACKAGE_NETWORK_MANAGER_CLI=y
BR2_PACKAGE_NTP=y
BR2_PACKAGE_NTP_SNTP=y
BR2_PACKAGE_NTP_NTP_SHM_CLK=y
BR2_PACKAGE_NTP_NTPD_ATOM_PPS=y
BR2_PACKAGE_NTP_NTPDATE=y
BR2_PACKAGE_NTP_NTPDC=y
BR2_PACKAGE_NTP_NTPQ=y
BR2_PACKAGE_NTP_NTPTIME=y
BR2_PACKAGE_NTP_TICKADJ=y
BR2_PACKAGE_OPENSSH=y
BR2_PACKAGE_SOCAT=y
BR2_PACKAGE_WIRELESS_REGDB=y
BR2_PACKAGE_WPA_SUPPLICANT=y
BR2_PACKAGE_WPA_SUPPLICANT_AP_SUPPORT=y
BR2_PACKAGE_WPA_SUPPLICANT_WIFI_DISPLAY=y
BR2_PACKAGE_WPA_SUPPLICANT_MESH_NETWORKING=y
BR2_PACKAGE_WPA_SUPPLICANT_AUTOSCAN=y
BR2_PACKAGE_WPA_SUPPLICANT_HOTSPOT=y
BR2_PACKAGE_WPA_SUPPLICANT_DEBUG_SYSLOG=y
BR2_PACKAGE_WPA_SUPPLICANT_WPS=y
BR2_PACKAGE_WPA_SUPPLICANT_WPA3=y
BR2_PACKAGE_WPA_SUPPLICANT_CLI=y
BR2_PACKAGE_WPA_SUPPLICANT_WPA_CLIENT_SO=y
BR2_PACKAGE_WPA_SUPPLICANT_PASSPHRASE=y
BR2_PACKAGE_WPA_SUPPLICANT_DBUS=y
BR2_PACKAGE_WPA_SUPPLICANT_DBUS_INTROSPECTION=y
BR2_PACKAGE_BASH_COMPLETION=y
BR2_PACKAGE_KEYUTILS=y
BR2_PACKAGE_KMOD_TOOLS=y
BR2_PACKAGE_MONIT=y
BR2_PACKAGE_UTIL_LINUX_BINARIES=y
BR2_PACKAGE_UTIL_LINUX_MOUNT=y
BR2_PACKAGE_UTIL_LINUX_RFKILL=y
BR2_PACKAGE_LESS=y
BR2_PACKAGE_NANO=y
# BR2_PACKAGE_NANO_TINY is not set
BR2_TARGET_ROOTFS_EXT2=y
BR2_TARGET_ROOTFS_EXT2_4=y
BR2_TARGET_ROOTFS_EXT2_SIZE="512M"
BR2_TARGET_UBOOT=y
BR2_TARGET_UBOOT_USE_CUSTOM_CONFIG=y
BR2_TARGET_UBOOT_CUSTOM_CONFIG_FILE="$(BR2_EXTERNAL_X6100_PATH)/board/X6100/u-boot/sun8i-r16-x6100_defconfig"
BR2_TARGET_UBOOT_NEEDS_DTC=y
BR2_TARGET_UBOOT_NEEDS_PYLIBFDT=y
BR2_TARGET_UBOOT_NEEDS_OPENSSL=y
BR2_TARGET_UBOOT_SPL=y
BR2_TARGET_UBOOT_SPL_NAME="u-boot-sunxi-with-spl.bin"
BR2_TARGET_UBOOT_CUSTOM_DTS_PATH="$(BR2_EXTERNAL_X6100_PATH)/board/X6100/dts/allwinner/sun8i-r16-x6100.dts"
BR2_PACKAGE_HOST_DOSFSTOOLS=y
BR2_PACKAGE_HOST_GENIMAGE=y
BR2_PACKAGE_HOST_MTOOLS=y
BR2_PACKAGE_HOST_UBOOT_TOOLS=y
BR2_PACKAGE_HOST_UBOOT_TOOLS_BOOT_SCRIPT=y
BR2_PACKAGE_HOST_UBOOT_TOOLS_BOOT_SCRIPT_SOURCE="$(BR2_EXTERNAL_X6100_PATH)/board/X6100/u-boot/boot.cmd"
BR2_PACKAGE_X6100_GUI=y
BR2_PACKAGE_RHVOICE_ENGLISH=y
BR2_PACKAGE_RHVOICE_SLT=y
BR2_PACKAGE_X6100_WEBSERVER=y
BR2_PACKAGE_FATE=y
```

## package/fate/Config.in
```kconfig
config BR2_PACKAGE_FATE
	bool "fate"
	depends on BR2_TOOLCHAIN_HAS_THREADS
	select BR2_PACKAGE_FFTW
	select BR2_PACKAGE_LIBSNDFILE
	select BR2_PACKAGE_PORTAUDIO
	help
	  JS8 text-only program
```

## package/freedv-backend/Config.in
```kconfig
config BR2_PACKAGE_FREEDV_BACKEND
	bool "freedv_backend"
	help
	  Common backend code shared by FreeDV projects
```

## package/radae-nopy/Config.in
```kconfig
config BR2_PACKAGE_RADAE_NOPY
	bool "radae_nopy"
	help
	  A version of RADAE which doesn't require python 
```
